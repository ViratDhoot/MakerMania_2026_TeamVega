#include <Wire.h>
#include <Adafruit_GFX.h>

// #define SMOL
#define BIG

#ifdef BIG
#include <Adafruit_SH110X.h>
#endif

#ifdef SMOL
#include <Adafruit_SSD1306.h>
#endif

// Screen Dimensions
#define SCREEN_WIDTH 128
#define SCREEN_HEIGHT 64
#ifdef BIG
#define SWHITE SH110X_WHITE
#endif
#ifdef SMOL
#define SWHITE WHITE
#endif

// MASKS
#define VISIT 0b10000
#define RIGHT 0b01000
#define LEFT 0b00100
#define TOP 0b00010
#define BOTTOM 0b00001

// Maze Dimensions
#define MAZE_H 50
#define MAZE_W 50

// JOYSTICK PINS
#define JOY_SW 27
#define JOY_X 32
#define JOY_Y 33

#ifdef BIG
Adafruit_SH1106G display(SCREEN_WIDTH, SCREEN_HEIGHT, &Wire, -1);
#endif
#ifdef SMOL
Adafruit_SSD1306 display(SCREEN_WIDTH, SCREEN_HEIGHT, &Wire, -1);
#endif

void setup() {
#ifdef BIG
  display.begin(0x3C, true);
#endif
#ifdef SMOL
  display.begin(SSD1306_SWITCHCAPVCC, 0x3C);
#endif
  display.clearDisplay();
  display.display();
  pinMode(JOY_SW, INPUT_PULLUP);
}

uint8_t arr[MAZE_W][MAZE_H] = {
  { 25, 26, 24, 25, 19, 18, 24, 24, 24, 24, 25, 18, 17,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 17, 26 },
  { 20, 29, 31, 23, 19, 26, 28, 28, 29, 23, 22, 24, 25,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 17, 30 },
  { 25, 22, 29, 18, 24, 20, 29, 23, 23, 18, 24, 29, 22,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 24, 28 },
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  { 17, 19, 19, 23, 18, 20, 20, 21, 19, 19, 18, 21, 18,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 18, 20 }
};

int8_t MAPPING[4][2] = {
  { 1, 0 }, { -1, 0 }, { 0, -1 }, { 0, 1 }
};
uint8_t DIM[2] = { 10, 10 };

void drawMaze(uint8_t maze[MAZE_W][MAZE_H], int ix, int iy) {
  int x = (SCREEN_WIDTH / 2) - ix;
  int y = (SCREEN_HEIGHT / 2) - iy;

  uint8_t cell, cx, cy;

  for (int i = max((ix / DIM[0]) - 5, 0); i < min(MAZE_W, (ix / DIM[0]) + 5); i++) {
    for (int j = max((iy / DIM[1]) - 5, 0); j < min(MAZE_H, (iy / DIM[1]) + 5); j++) {
      cell = maze[i][j];
      cx = (i * DIM[0]) + x;
      cy = (j * DIM[1]) + y;
      if ((cell & TOP) == 0)
        display.drawLine(cx, cy, cx + DIM[0], cy, SWHITE);
      if ((cell & LEFT) == 0)
        display.drawLine(cx, cy, cx, cy + DIM[1], SWHITE);
      if (i == MAZE_W - 1)
        display.drawLine(cx + DIM[0] - 1, cy, cx + DIM[0] - 1, cy + DIM[1], SWHITE);
      if (j == MAZE_H - 1)
        display.drawLine(cx, cy + DIM[1] - 1, cx + DIM[0], cy + DIM[1] - 1, SWHITE);
    }
  }
}

float x = DIM[0] / 2.0;
float y = DIM[1] / 2.0;

float speed = 1.0;
int size = 2;
int ix, iy;
int cell;
float mag;
float arrow[2];

void loop() {
  display.clearDisplay();
  drawMaze(arr, x, y);
  float joyX = (analogRead(JOY_X) - 2047.5f) / 2047.5f;
  float joyY = (analogRead(JOY_Y) - 2047.5f) / 2047.5f;

  if (abs(joyX) < 0.10f)
    joyX = 0;

  if (abs(joyY) < 0.10f)
    joyY = 0;

  x += joyX * speed;
  y += joyY * speed;

  ix = int(x / DIM[0]);
  iy = int(y / DIM[1]);

  ix = constrain(ix, 0, MAZE_W - 1);
  iy = constrain(iy, 0, MAZE_H - 1);

  cell = arr[ix][iy];
  if (((cell & LEFT) == 0) && ((x - size) < (ix * DIM[0] + 1)))
    x = ix * DIM[0] + size + 1;
  if (((cell & RIGHT) == 0) && ((x + size) > ((ix + 1) * DIM[0] - 1)))
    x = (ix + 1) * DIM[0] - size - 1;
  if (((cell & TOP) == 0) && ((y - size) < (iy * DIM[1] + 1)))
    y = iy * DIM[1] + size + 1;
  if (((cell & BOTTOM) == 0) && ((y + size) > ((iy + 1) * DIM[1] - 1)))
    y = (iy + 1) * DIM[1] - size - 1;
  display.fillCircle(SCREEN_WIDTH / 2, SCREEN_HEIGHT / 2, size, SWHITE);
  arrow[0] = MAZE_W / 2 - x / DIM[0];
  arrow[1] = MAZE_H / 2 - y / DIM[1];
  mag = sqrt(
    arrow[0] * arrow[0] + arrow[1] * arrow[1]);
  if (abs(mag) > 3) {
    arrow[0] /= mag;
    arrow[1] /= mag;

    arrow[0] *= SCREEN_WIDTH / 2;
    arrow[1] *= SCREEN_HEIGHT / 2;

    arrow[0] += SCREEN_WIDTH / 2;
    arrow[1] += SCREEN_HEIGHT / 2;

    display.fillCircle(
      (int)arrow[0],
      (int)arrow[1],
      1,
      SWHITE);
  }
  display.display();
  if (!digitalRead(JOY_SW)) {
    Serial.println("Pressed");
  }
}